## sources/meta-bogate/conf/layer.conf
```bitbake
BBPATH .= ":${LAYERDIR}"

BBFILES += "${LAYERDIR}/recipes-*/*/*.bb" \
           "${LAYERDIR}/recipes-*/*/*.bbappend"

BBFILE_COLLECTIONS += "meta-bogate"
BBFILE_PATTERN_meta-bogate = "^${LAYERDIR}/"
BBFILE_PRIORITY_meta-bogate = "10"

LAYERDEPENDS_meta-bogate = "core"
LAYERSERIES_COMPAT_meta-bogate = "scarthgap"
```
